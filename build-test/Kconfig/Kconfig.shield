## build-test/Kconfig/Kconfig.shield
```kconfig
osource "/workspaces/ZMK-tf2/zmk/app/module/boards/shields/*/Kconfig.shield"
osource "/workspaces/ZMK-tf2/zmk/app/boards/shields/*/Kconfig.shield"
```

## build-test/Kconfig/Kconfig.shield.defconfig
```kconfig
osource "/workspaces/ZMK-tf2/zmk/app/module/boards/shields/*/Kconfig.defconfig"
osource "/workspaces/ZMK-tf2/zmk/app/boards/shields/*/Kconfig.defconfig"
```

## build-test/Kconfig/arch/Kconfig
```kconfig
# Load Zephyr Arch Kconfig descriptions.
osource "/workspaces/ZMK-tf2/zephyr/arch/x86/Kconfig"
osource "/workspaces/ZMK-tf2/zephyr/arch/xtensa/Kconfig"
osource "/workspaces/ZMK-tf2/zephyr/arch/sparc/Kconfig"
osource "/workspaces/ZMK-tf2/zephyr/arch/riscv/Kconfig"
osource "/workspaces/ZMK-tf2/zephyr/arch/posix/Kconfig"
osource "/workspaces/ZMK-tf2/zephyr/arch/nios2/Kconfig"
osource "/workspaces/ZMK-tf2/zephyr/arch/mips/Kconfig"
osource "/workspaces/ZMK-tf2/zephyr/arch/arm64/Kconfig"
osource "/workspaces/ZMK-tf2/zephyr/arch/arm/Kconfig"
osource "/workspaces/ZMK-tf2/zephyr/arch/arc/Kconfig"
```

## build-test/Kconfig/boards/Kconfig
```kconfig
# Load Zephyr board Kconfig descriptions.
osource "/workspaces/ZMK-tf2/zmk/app/module/boards/nicekeyboards/nice_nano/Kconfig"
osource "/workspaces/ZMK-tf2/zmk/app/boards/nicekeyboards/nice_nano/Kconfig"
```

## build-test/Kconfig/boards/Kconfig.defconfig
```kconfig
# Load Zephyr board defconfig descriptions.
osource "/workspaces/ZMK-tf2/zmk/app/module/boards/nicekeyboards/nice_nano/Kconfig.defconfig"
osource "/workspaces/ZMK-tf2/zmk/app/boards/nicekeyboards/nice_nano/Kconfig.defconfig"
```

## build-test/Kconfig/boards/Kconfig.nice_nano
```kconfig
# Load board Kconfig descriptions.
osource "/workspaces/ZMK-tf2/zmk/app/boards/nicekeyboards/nice_nano/Kconfig.nice_nano"
```

## build-test/Kconfig/boards/Kconfig.sysbuild
```kconfig
# Load Sysbuild board Kconfig descriptions.
osource "/workspaces/ZMK-tf2/zmk/app/boards/nicekeyboards/nice_nano/Kconfig.sysbuild"
```

## config/boards/shields/planckton/Kconfig.shield
```kconfig
# Copyright (c) 2025
# SPDX-License-Identifier: MIT

config SHIELD_PLANCKTON
    def_bool $(shields_list_contains,planckton)
```

## config/boards/tipper/tipper_tf/Kconfig.board
```kconfig
# Tipper TF board configuration
#
# Copyright (c) 2025
# SPDX-License-Identifier: MIT

config BOARD_TIPPER_TF
	bool "Tipper TF"
	select SOC_NRF52840_QIAA
	select HAS_NRFX
	imply RETAINED_MEM
	imply RETENTION
	imply RETENTION_BOOT_MODE
```

## config/boards/tipper/tipper_tf/Kconfig.defconfig
```kconfig
# Copyright (c) 2025
# SPDX-License-Identifier: MIT

if BOARD_TIPPER_TF

config BOARD
	default "Tipper TF"

config ZMK_KEYBOARD_NAME
	default "Tipper TF"

config HAS_NRFX
	default y

if USB_DEVICE_STACK

config USB_NRFX
	default y

endif # USB_DEVICE_STACK

config BT_CTLR
	default BT

config ZMK_BLE
	default y

config ZMK_USB
	default y

config ZMK_BATTERY_VOLTAGE_DIVIDER
	default y

config ZMK_DISPLAY
	select LV_USE_CONT
	select LV_USE_LABEL
	select LV_USE_IMAGE
	select LV_USE_CANVAS
	select LV_FONT_MONTSERRAT_26

choice ZMK_DISPLAY_STATUS_SCREEN
	default ZMK_DISPLAY_STATUS_SCREEN_CUSTOM
endchoice

if ZMK_DISPLAY

config SPI
	default y

config JD79653
	default y

config ZMK_DISPLAY_BLANK_ON_IDLE
	default n

config HEAP_MEM_POOL_SIZE
	default 1024

config LV_Z_MEM_POOL_SIZE
	default 4096

endif # ZMK_DISPLAY

if LVGL

config LV_Z_VDB_SIZE
	default 100

config LV_DPI_DEF
	default 184

config LV_Z_BITS_PER_PIXEL
	default 1

choice LV_COLOR_DEPTH
	default LV_COLOR_DEPTH_1
endchoice

endif # LVGL

menuconfig CUSTOM_WIDGET_BATTERY_STATUS
	bool "custom battery status widget"

config RETAINED_MEM
	default y

config RETENTION
	default y

config RETENTION_BOOT_MODE
	default y

# Explicitly set bootloader type for Adafruit nRF52 bootloader
# This ensures the correct magic value (0x57) is used
choice ZMK_BOOTMODE_MAGIC_VALUE_BOOTLOADER_TYPE
	default ZMK_BOOTMODE_MAGIC_VALUE_BOOTLOADER_TYPE_ADAFRUIT_NRF52

endchoice

endif # BOARD_TIPPER_TF
```

## config/boards/tipper/tipper_tf/Kconfig.tipper_tf
```kconfig
# Copyright (c) 2025
# SPDX-License-Identifier: MIT

config BOARD_TIPPER_TF
	bool "Tipper TF"
	select SOC_NRF52840_QIAA
	select HAS_NRFX
```

## for reference only/display driver - app/drivers/display/Kconfig
```kconfig
rsource "Kconfig.il0323"
rsource "Kconfig.jd79653"
rsource "Kconfig.gdew0154m09"
```

## for reference only/display driver - app/drivers/display/Kconfig.gdew0154m09
```kconfig
# Copyright (c) 2024 The ZMK Contributors
# SPDX-License-Identifier: MIT

config GDEW0154M09
	bool "GoodDisplay GDEW0154M09 EPD display driver"
	default y
	depends on DT_HAS_GOODDISPLAY_GDEW0154M09_ENABLED
	select SPI
	help
	  Enable support for GoodDisplay GDEW0154M09 EPD display.
```

## for reference only/display driver - app/dts/bindings/display/gooddisplay,gdew0154m09.yaml
```yaml
# Copyright (c) 2024 The ZMK Contributors
# SPDX-License-Identifier: MIT

description: GoodDisplay GDEW0154M09 EPD Controller

compatible: "gooddisplay,gdew0154m09"

include: [spi-device.yaml]

properties:
  width:
    type: int
    required: true
    description: Display width in pixels

  height:
    type: int
    required: true
    description: Display height in pixels

  reset-gpios:
    type: phandle-array
    required: true
    description: RESET signal

  dc-gpios:
    type: phandle-array
    required: true
    description: Data/Command signal

  busy-gpios:
    type: phandle-array
    required: true
    description: BUSY signal

  pwr:
    type: uint8-array
    required: false
    description: Power setting configuration
```
